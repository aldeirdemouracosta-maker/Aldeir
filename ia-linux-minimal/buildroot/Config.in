## ia-linux-minimal/buildroot/Config.in
```kconfig
source "$BR2_EXTERNAL_IA_LINUX_PATH/package/ai-core/Config.in"
source "$BR2_EXTERNAL_IA_LINUX_PATH/package/ai-shell/Config.in"
```

## ia-linux-minimal/buildroot/configs/ia_linux_qemu_x86_64_defconfig
```kconfig
# IA Linux Minimal — alvo QEMU x86_64 (desenvolvimento, CPU-only)
# Buildroot 2026.08 / Linux 6.18 LTS

BR2_x86_64=y
BR2_X86_CPU_HAS_SSE4=y

# Toolchain
BR2_TOOLCHAIN_BUILDROOT_GLIBC=y
BR2_TOOLCHAIN_BUILDROOT_CXX=y
BR2_TOOLCHAIN_BUILDROOT_WCHAR=y

# Sistema
BR2_TARGET_GENERIC_HOSTNAME="ia-linux"
BR2_TARGET_GENERIC_ISSUE="IA Linux Minimal"
BR2_INIT_BUSYBOX=y
BR2_SYSTEM_BIN_SH_BUSYBOX=y
BR2_TARGET_GENERIC_GETTY_PORT="ttyS0"
BR2_TARGET_GENERIC_ROOT_PASSWD=""

# Kernel
BR2_LINUX_KERNEL=y
BR2_LINUX_KERNEL_CUSTOM_VERSION=y
BR2_LINUX_KERNEL_CUSTOM_VERSION_VALUE="6.18.52"
BR2_LINUX_KERNEL_USE_CUSTOM_CONFIG=y
BR2_LINUX_KERNEL_CUSTOM_CONFIG_FILE="$(BR2_EXTERNAL_IA_LINUX_PATH)/kernel/config/ia_linux_x86_64.config"
BR2_LINUX_KERNEL_CONFIG_FRAGMENT_FILES="$(BR2_EXTERNAL_IA_LINUX_PATH)/kernel/config/qemu.fragment"
BR2_LINUX_KERNEL_BZIMAGE=y
BR2_LINUX_KERNEL_NEEDS_HOST_LIBELF=y

# Sem GPU virtual no QEMU (decisão intencional — ver docs/architecture.md)
# BR2_PACKAGE_MESA3D is not set

# Filesystem imagens
BR2_TARGET_ROOTFS_EXT2=y
BR2_TARGET_ROOTFS_EXT2_4=y
BR2_TARGET_ROOTFS_EXT2_SIZE="512M"

# BusyBox + utilitários mínimos
BR2_PACKAGE_BUSYBOX_SHOW_OTHERS=y

# Pacotes de IA
BR2_PACKAGE_LLAMA_CPP=y
# BR2_PACKAGE_LLAMA_CPP_VULKAN is not set
BR2_PACKAGE_LLAMA_CPP_TOOLS=y

# Pacotes próprios (BR2_EXTERNAL)
BR2_PACKAGE_AI_CORE=y
BR2_PACKAGE_AI_SHELL=y

# Overlay
BR2_ROOTFS_OVERLAY="$(BR2_EXTERNAL_IA_LINUX_PATH)/rootfs-overlay"
BR2_ROOTFS_POST_BUILD_SCRIPT="$(BR2_EXTERNAL_IA_LINUX_PATH)/buildroot/board/ia-linux/post-build.sh"

# cgroups v2 / eBPF / zram (preparação para AI Resource Manager e AI Scheduler)
BR2_PACKAGE_LIBBPF=y
BR2_PACKAGE_BPFTOOL=y

# Ferramentas de diagnóstico mínimas
BR2_PACKAGE_UTIL_LINUX=y
BR2_PACKAGE_UTIL_LINUX_BINARIES=y
```

## ia-linux-minimal/buildroot/configs/ia_linux_uefi_x86_64_defconfig
```kconfig
# IA Linux Minimal — alvo PC físico x86_64, boot UEFI 64-bit (GRUB)
# Idêntico a ia_linux_bios_x86_64_defconfig, exceto pela pilha de boot.
# Buildroot 2026.08 / Linux 6.18 LTS

BR2_x86_64=y
BR2_X86_CPU_HAS_SSE4=y

BR2_TOOLCHAIN_BUILDROOT_GLIBC=y
BR2_TOOLCHAIN_BUILDROOT_CXX=y
BR2_TOOLCHAIN_BUILDROOT_WCHAR=y

BR2_TARGET_GENERIC_HOSTNAME="ia-linux"
BR2_TARGET_GENERIC_ISSUE="IA Linux Minimal"
BR2_INIT_BUSYBOX=y
BR2_SYSTEM_BIN_SH_BUSYBOX=y
BR2_TARGET_GENERIC_GETTY_PORT="tty1"

BR2_LINUX_KERNEL=y
BR2_LINUX_KERNEL_CUSTOM_VERSION=y
BR2_LINUX_KERNEL_CUSTOM_VERSION_VALUE="6.18.52"
BR2_LINUX_KERNEL_USE_CUSTOM_CONFIG=y
BR2_LINUX_KERNEL_CUSTOM_CONFIG_FILE="$(BR2_EXTERNAL_IA_LINUX_PATH)/kernel/config/ia_linux_x86_64.config"
BR2_LINUX_KERNEL_CONFIG_FRAGMENT_FILES="$(BR2_EXTERNAL_IA_LINUX_PATH)/kernel/config/physical.fragment"
BR2_LINUX_KERNEL_BZIMAGE=y
BR2_LINUX_KERNEL_NEEDS_HOST_LIBELF=y
BR2_LINUX_KERNEL_INSTALL_TARGET=y

BR2_PACKAGE_LINUX_FIRMWARE=y
BR2_PACKAGE_LINUX_FIRMWARE_AMDGPU=y

# GRUB2 — boot UEFI x86_64
BR2_TARGET_GRUB2=y
BR2_TARGET_GRUB2_X86_64_EFI=y
BR2_TARGET_GRUB2_BUILTIN_MODULES_EFI="part_gpt fat ext2 efi_gop"
BR2_TARGET_GRUB2_BUILTIN_CONFIG_EFI="$(BR2_EXTERNAL_IA_LINUX_PATH)/buildroot/board/ia-linux/grub.cfg"

BR2_TARGET_ROOTFS_EXT2=y
BR2_TARGET_ROOTFS_EXT2_4=y
BR2_TARGET_ROOTFS_EXT2_SIZE="2048M"
BR2_TARGET_ROOTFS_EXT2_LABEL="IA_SYSTEM"
BR2_ROOTFS_POST_IMAGE_SCRIPT="$(BR2_EXTERNAL_IA_LINUX_PATH)/buildroot/board/ia-linux/post-image.sh"
BR2_ROOTFS_POST_IMAGE_SCRIPT_ARGS="uefi"

BR2_PACKAGE_MESA3D=y
BR2_PACKAGE_MESA3D_VULKAN_DRIVER_AMD=y
BR2_PACKAGE_VULKAN_LOADER=y
BR2_PACKAGE_VULKAN_HEADERS=y
BR2_PACKAGE_VULKAN_TOOLS=y

BR2_PACKAGE_LLAMA_CPP=y
BR2_PACKAGE_LLAMA_CPP_VULKAN=y
BR2_PACKAGE_LLAMA_CPP_TOOLS=y

BR2_PACKAGE_UTIL_LINUX=y
BR2_PACKAGE_UTIL_LINUX_BINARIES=y
BR2_PACKAGE_PCIUTILS=y
BR2_PACKAGE_USBUTILS=y

BR2_PACKAGE_LIBBPF=y
BR2_PACKAGE_BPFTOOL=y

BR2_PACKAGE_AI_CORE=y
BR2_PACKAGE_AI_SHELL=y

BR2_ROOTFS_OVERLAY="$(BR2_EXTERNAL_IA_LINUX_PATH)/rootfs-overlay"
BR2_ROOTFS_POST_BUILD_SCRIPT="$(BR2_EXTERNAL_IA_LINUX_PATH)/buildroot/board/ia-linux/post-build.sh"
```

## ia-linux-minimal/package/ai-core/Config.in
```kconfig
config BR2_PACKAGE_AI_CORE
	bool "ai-core"
	depends on BR2_PACKAGE_HOST_RUSTC_TARGET_CPU_ARCHS_SUPPORTS
	help
	  Daemon central do IA Linux Minimal: detecção de hardware,
	  gerenciamento de modelos GGUF e seleção de backend de inferência
	  (CPU/Vulkan), exposto via socket Unix (/run/ai-core.sock) a
	  ia-shell e aos demais utilitários ia-*.

	  Compilado a partir de ai-core/ (na raiz deste BR2_EXTERNAL) via
	  infraestrutura cargo-package do Buildroot.

comment "ai-core precisa de um toolchain host com suporte a Rust"
	depends on !BR2_PACKAGE_HOST_RUSTC_TARGET_CPU_ARCHS_SUPPORTS
```

## ia-linux-minimal/package/ai-shell/Config.in
```kconfig
config BR2_PACKAGE_AI_SHELL
	bool "ai-shell"
	select BR2_PACKAGE_AI_CORE
	select BR2_PACKAGE_UTIL_LINUX
	select BR2_PACKAGE_UTIL_LINUX_LSBLK
	help
	  Console interativo (prompt "IA>") e utilitários de linha de
	  comando (ia-model, ia-chat, ia-benchmark, ia-server, ia-gpu,
	  ia-hwdetect) do IA Linux Minimal.

	  Os scripts em si são instalados via BR2_ROOTFS_OVERLAY
	  (rootfs-overlay/usr/bin, rootfs-overlay/etc) — este pacote não
	  compila nada; ele apenas garante, via 'select', que ai-core e as
	  ferramentas de diagnóstico das quais os scripts dependem estejam
	  presentes na imagem final.
```

## ia-linux-minivideo/image/Config.in
```kconfig
menu "IA-Linux MiniVideo"
source "$BR2_EXTERNAL_IA_MINIVIDEO_PATH/package/minivideo-tools/Config.in"
source "$BR2_EXTERNAL_IA_MINIVIDEO_PATH/package/whisper-cpp/Config.in"
source "$BR2_EXTERNAL_IA_MINIVIDEO_PATH/package/auto-editor-bin/Config.in"
source "$BR2_EXTERNAL_IA_MINIVIDEO_PATH/package/rife-ncnn-vulkan-bin/Config.in"
source "$BR2_EXTERNAL_IA_MINIVIDEO_PATH/package/realesrgan-ncnn-vulkan-bin/Config.in"
endmenu
```

## ia-linux-minivideo/image/package/auto-editor-bin/Config.in
```kconfig
config BR2_PACKAGE_AUTO_EDITOR_BIN
	bool "auto-editor (binário oficial)"
	depends on BR2_x86_64
	depends on BR2_TOOLCHAIN_USES_GLIBC
	depends on BR2_INSTALL_LIBSTDCPP
	depends on BR2_GCC_ENABLE_OPENMP # libgomp
	help
	  Remove silêncios e trechos parados de vídeos. Binário oficial
	  (traz o próprio FFmpeg embutido). Testado nesta sessão em CPU
	  SandyBridge/IvyBridge emulada: sem instruções AVX2.

	  https://github.com/WyattBlue/auto-editor

comment "auto-editor precisa de glibc, C++ e OpenMP (BR2_GCC_ENABLE_OPENMP)"
	depends on BR2_x86_64
	depends on !BR2_TOOLCHAIN_USES_GLIBC || !BR2_INSTALL_LIBSTDCPP || !BR2_GCC_ENABLE_OPENMP
```

## ia-linux-minivideo/image/package/minivideo-tools/Config.in
```kconfig
config BR2_PACKAGE_MINIVIDEO_TOOLS
	bool "minivideo-tools"
	depends on BR2_PACKAGE_PYTHON3
	select BR2_PACKAGE_PYTHON3_CURSES
	select BR2_PACKAGE_NCURSES_WCHAR
	help
	  Interface de pastas (minivideo-ui), agentes de vídeo
	  (minivideo-agentes), auditoria (minivideo-audit) e Hardware
	  Safety Guard (minivideo-guard). Sem dependências Python extras.

comment "minivideo-tools precisa de python3"
	depends on !BR2_PACKAGE_PYTHON3
```

## ia-linux-minivideo/image/package/realesrgan-ncnn-vulkan-bin/Config.in
```kconfig
config BR2_PACKAGE_REALESRGAN_NCNN_VULKAN_BIN
	bool "realesrgan-ncnn-vulkan (binário oficial)"
	depends on BR2_x86_64
	depends on BR2_TOOLCHAIN_USES_GLIBC
	depends on BR2_GCC_ENABLE_OPENMP # libgomp
	select BR2_PACKAGE_VULKAN_LOADER
	help
	  Upscale Real-ESRGAN (ncnn + Vulkan), binário do release oficial
	  v0.2.5.0 (glibc >= 2.29). Instala os modelos em
	  /usr/share/minivideo/modelos/realesrgan/models/ (o binário exige
	  "models" no caminho).

	  https://github.com/xinntao/Real-ESRGAN

comment "realesrgan-ncnn-vulkan precisa de glibc e OpenMP (BR2_GCC_ENABLE_OPENMP)"
	depends on BR2_x86_64
	depends on !BR2_TOOLCHAIN_USES_GLIBC || !BR2_GCC_ENABLE_OPENMP
```

## ia-linux-minivideo/image/package/rife-ncnn-vulkan-bin/Config.in
```kconfig
config BR2_PACKAGE_RIFE_NCNN_VULKAN_BIN
	bool "rife-ncnn-vulkan (binário oficial)"
	depends on BR2_x86_64
	depends on BR2_TOOLCHAIN_USES_GLIBC
	depends on BR2_INSTALL_LIBSTDCPP
	depends on BR2_GCC_ENABLE_OPENMP # libgomp
	select BR2_PACKAGE_VULKAN_LOADER
	help
	  Interpolação de quadros RIFE (ncnn + Vulkan), binário do release
	  oficial 20221029 (Ubuntu, glibc >= 2.15). Instala só o modelo
	  rife-v4.6 em /usr/share/minivideo/modelos/rife/.

	  https://github.com/nihui/rife-ncnn-vulkan

comment "rife-ncnn-vulkan precisa de glibc, C++ e OpenMP (BR2_GCC_ENABLE_OPENMP)"
	depends on BR2_x86_64
	depends on !BR2_TOOLCHAIN_USES_GLIBC || !BR2_INSTALL_LIBSTDCPP || !BR2_GCC_ENABLE_OPENMP
```

## ia-linux-minivideo/image/package/whisper-cpp/Config.in
```kconfig
config BR2_PACKAGE_WHISPER_CPP
	bool "whisper.cpp"
	depends on BR2_INSTALL_LIBSTDCPP
	depends on BR2_TOOLCHAIN_HAS_THREADS
	depends on BR2_TOOLCHAIN_GCC_AT_LEAST_9
	depends on BR2_USE_WCHAR
	help
	  Transcrição de fala (Whisper) em C/C++ — instala whisper-cli.
	  Modelos ggml-*.bin ficam fora da imagem, em Modelos/whisper/.

	  https://github.com/ggml-org/whisper.cpp

if BR2_PACKAGE_WHISPER_CPP

config BR2_PACKAGE_WHISPER_CPP_VULKAN
	bool "Vulkan (RADV / RX 580)"
	depends on !BR2_STATIC_LIBS
	select BR2_PACKAGE_VULKAN_LOADER
	select BR2_PACKAGE_VULKAN_HEADERS

endif
```
